## board/nintendo/hac-001/Kconfig
```kconfig
if TARGET_HAC_001

config SYS_BOARD
	default "hac-001"

config SYS_VENDOR
	default "nintendo"

config SYS_CONFIG_NAME
	default "hac-001"

endif
```

## configs/hac-001_defconfig
```kconfig
CONFIG_ARM=y
CONFIG_TEGRA=y
CONFIG_SYS_TEXT_BASE=0xA0000000
CONFIG_TEGRA210=y
CONFIG_DEFAULT_DEVICE_TREE="tegra210-hac-001"
CONFIG_OF_SYSTEM_SETUP=y
CONFIG_CONSOLE_MUX=y
CONFIG_SYS_STDIO_DEREGISTER=y
CONFIG_SYS_PROMPT="Tegra210 (HAC-001) # "
# CONFIG_CMD_IMI is not set
CONFIG_CMD_DFU=y
# CONFIG_CMD_FLASH is not set
CONFIG_CMD_GPIO=y
CONFIG_CMD_I2C=y
CONFIG_CMD_MMC=y
CONFIG_CMD_SF=y
CONFIG_CMD_SPI=n
CONFIG_CMD_USB=y
CONFIG_CMD_USB_MASS_STORAGE=y
# CONFIG_CMD_SETEXPR is not set
# CONFIG_CMD_NFS is not set
CONFIG_CMD_EXT4_WRITE=y
CONFIG_DFU_MMC=y
CONFIG_DFU_RAM=y
CONFIG_DFU_SF=y
CONFIG_SPI_FLASH=n
CONFIG_SPI_FLASH_WINBOND=n
CONFIG_SYS_NS16550=y
CONFIG_TEGRA114_SPI=y
CONFIG_USB=y
CONFIG_DM_USB=y
CONFIG_USB_EHCI_HCD=y
CONFIG_USB_STORAGE=y
CONFIG_USB_GADGET=y
CONFIG_USB_GADGET_MANUFACTURER="NVIDIA"
CONFIG_USB_GADGET_VENDOR_NUM=0x0955
CONFIG_USB_GADGET_PRODUCT_NUM=0x701a
CONFIG_CI_UDC=y
CONFIG_USB_GADGET_DOWNLOAD=y
CONFIG_REQUIRE_SERIAL_CONSOLE=n
CONFIG_FASTBOOT=y
USB_FUNCTION_MASS_STORAGE=y
CONFIG_USB_KEYBOARD=y
CONFIG_BOOTCOMMAND="run distro_bootcmd"
CONFIG_FASTBOOT_BUF_ADDR=0xC0000000
CONFIG_MMC_IO_VOLTAGE=y
CONFIG_MMC_UHS_SUPPORT=y
CONFIG_ANDROID_BOOT_IMAGE=y
CONFIG_IMAGE_FORMAT_LEGACY=y
CONFIG_SUPPORT_RAW_INITRD=y
CONFIG_CMD_SETEXPR=y
```

## fs/fat/Kconfig
```kconfig
config FS_FAT
	bool "Enable FAT filesystem support"
	help
	  This provides support for reading images from File Allocation Table
	  (FAT) filesystem. FAT filesystem is a legacy, lightweight filesystem.
	  It is useful mainly for its wide compatibility with various operating
	  systems. You can also enable CMD_FAT to get access to fat commands.

config FAT_WRITE
	bool "Enable FAT filesystem write support"
	depends on FS_FAT
	help
	  This provides support for creating and writing new files to an
	  existing FAT filesystem partition.
```
